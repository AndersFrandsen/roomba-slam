## yocto/meta-robobob/conf/layer.conf
```bitbake
BBPATH .= ":${LAYERDIR}"

BBFILES += "${LAYERDIR}/recipes-*/*/*.bb ${LAYERDIR}/recipes-*/*/*.bbappend"

BBFILE_COLLECTIONS += "robobob"
BBFILE_PATTERN_robobob = "^${LAYERDIR}/"
BBFILE_PRIORITY_robobob = "10"

LAYERDEPENDS_robobob = "core openembedded-layer raspberrypi"
LAYERSERIES_COMPAT_robobob = "scarthgap"
```
